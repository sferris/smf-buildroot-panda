## package/linux-pam/Config.in
```kconfig
config BR2_PACKAGE_PAM
	bool "linux-pam"
        select BR2_PACKAGE_GETTEXT
        select BR2_PACKAGE_LIBINTL
	help
	  Pluggable Authentication Modules is a flexible mechanism for authenticating users.


	  http://www.kernel.org/pub/linux/libs/pam/whatispam.html
```

## package/multimedia/fmtools/Config.in
```kconfig
config BR2_PACKAGE_FMTOOLS
	bool "fmtools"
	help
          fmtools is a pair of simple command-line utilities for video4linux2
	  radio tuner cards under Linux.

	  http://benpfaff.org/fmtools/
```
